## boards/shields/ergodox-ezbl/Kconfig.defconfig
```kconfig
# Copyright (c) 2020 The ZMK Contributors
# SPDX-License-Identifier: MIT

if SHIELD_ERGODOX_EZBL_RIGHT

config ZMK_KEYBOARD_NAME
    default "Ergodox EZBL"

config ZMK_SPLIT_ROLE_CENTRAL
    default y

endif

if SHIELD_ERGODOX_EZBL_RIGHT || SHIELD_ERGODOX_EZBL_LEFT

config ZMK_SPLIT
    default y

endif
```

## boards/shields/ergodox-ezbl/Kconfig.shield
```kconfig
# Copyright (c) 2020 The ZMK Contributors
# SPDX-License-Identifier: MIT

config SHIELD_ERGODOX_EZBL_LEFT
    def_bool $(shields_list_contains,ergodox_ezbl_left)

config SHIELD_ERGODOX_EZBL_RIGHT
    def_bool $(shields_list_contains,ergodox_ezbl_right)
```
